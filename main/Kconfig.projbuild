## main/Kconfig.projbuild
```kconfig
menu "Hardware Configuration"
    choice TARGET_HARDWARE
        prompt "Target Hardware"
        default TARGET_HARDWARE_T3_DONGLE
        help
            Select the target hardware for the example.

        config TARGET_HARDWARE_T3_DONGLE
            depends on IDF_TARGET_ESP32S3
            bool "LilyGo T3 Dongle"

        config TARGET_HARDWARE_QTPY_ESP32_S3
            depends on IDF_TARGET_ESP32S3
            bool "Adafruit QT Py ESP32-S3"

    endchoice
endmenu

menu "Bridge Configuration"
    choice BRIDGE_MODE
        prompt "Bridge mode"
        default BRIDGE_MODE_SWITCH_PRO
        help
            Select what the dongle bridges from BLE to USB.

        config BRIDGE_MODE_SWITCH_PRO
            bool "Xbox controller -> Switch Pro controller"
            help
                Pairs with an Xbox (BLE) controller and presents a wired
                Nintendo Switch Pro controller on USB.

        config BRIDGE_MODE_HID_PASSTHROUGH
            bool "BLE HID device -> USB HID device (passthrough)"
            help
                Pairs with any BLE HID device (keyboard, mouse, ...) and
                presents the same HID device on USB: its Report Map is used as
                the USB report descriptor and every input report is forwarded
                as is. The Report Map is cached in NVS; when a newly paired
                device's map differs, the dongle restarts once to enumerate
                with it.

    endchoice

    if BRIDGE_MODE_HID_PASSTHROUGH
        config DONGLE_USB_VID
            hex "USB vendor id"
            default 0x1209
            help
                USB vendor id of the dongle. The default (pid.codes) is meant
                for development only; use an id you are allowed to use before
                distributing devices.

        config DONGLE_USB_PID
            hex "USB product id"
            default 0x0001
            help
                USB product id of the dongle (the pid.codes test PID by
                default).

        config DONGLE_USB_MANUFACTURER
            string "USB manufacturer string"
            default "esp-usb-ble-hid"

        config DONGLE_USB_PRODUCT
            string "USB product string"
            default "BLE HID Passthrough"
    endif
endmenu

menu "USB Configuration"
    config DONGLE_USB_VENDOR_INTERFACE
        bool "Add a vendor (WebUSB) interface for the dongle console"
        default y
        help
            Adds a vendor-class interface next to the Switch Pro HID interface.
            It carries the espp dispatcher stream (device configuration, OTA
            firmware update and crash-dump download) used by the browser
            console (web/dongle_console.html). Disable this to present a plain
            single-interface HID gamepad, e.g. if a host refuses the composite
            device.

    config DONGLE_USB_CDC_CONSOLE
        bool "Add a CDC-ACM interface carrying the log console"
        default n
        help
            Adds a USB serial (CDC-ACM) interface and routes the ESP console
            (logs) to it, so `idf.py monitor` / any serial terminal works over
            the same USB cable. Off by default to keep the device descriptor
            minimal for the Nintendo Switch.
endmenu
```
